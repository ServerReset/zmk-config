## boards/shields/BEST_BOARD_EVER/Kconfig.defconfig
```kconfig
# Copyright (c) 2020 The ZMK Contributors
# SPDX-License-Identifier: MIT

if SHIELD_BEST_BOARD_EVER
config ZMK_KEYBOARD_NAME
	default "Best Board Ever"
config ZMK_SLEEP
  default y
config ZMK_IDLE_TIMEOUT
  default 30000
config ZMK_IDLE_SLEEP_TIMEOUT
  default 600000
config ZMK_BATTERY_REPORTING
  default y
config ZMK_BATTERY_REPORT_INTERVAL
  default 120
config BT_GATT_ENFORCE_SUBSCRIPTION
  default n
config BT_MAX_PAIRED
  default 3
config BT_MAX_CONN
  default 3
config ZMK_PM_SOFT_OFF
  default y
config ZMK_MACRO_DEFAULT_WAIT_MS
  default 50
config ZMK_MACRO_DEFAULT_TAP_MS
  default 100
endif
```
